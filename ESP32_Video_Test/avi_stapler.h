#include <Arduino.h>
#include <FS.h>

unsigned long movi_size = 0;

void start_avi(File &file) {
  // 30 FPS, CIF (400x296) AVI Header
  const uint8_t avi_header[324] = {
    0x52, 0x49, 0x46, 0x46, 0x00, 0x00, 0x00, 0x00, 0x41, 0x56, 0x49, 0x20, 0x4C, 0x49, 0x53, 0x54,
    0x30, 0x01, 0x00, 0x00, 0x68, 0x64, 0x72, 0x6C, 0x61, 0x76, 0x69, 0x68, 0x38, 0x00, 0x00, 0x00,
    0x35, 0x82, 0x00, 0x00, 0x00, 0x00, 0x00, 0x00, 0x00, 0x00, 0x00, 0x00, 0x10, 0x01, 0x00, 0x00,
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    0x32, 0x43, 0x41, 0x4D, 0x4C, 0x49, 0x53, 0x54, 0x00, 0x00, 0x00, 0x00, 0x6D, 0x6F, 0x76, 0x69
  };
  
  file.write(avi_header, sizeof(avi_header));
  movi_size = 0; 
}

void add_frame(File &file, uint8_t *buf, size_t len) {
  uint8_t padding = len % 2;
  uint32_t frame_size = len + padding;
  uint32_t total_chunk_size = 8 + len + padding;

  uint8_t *chunk_buffer = (uint8_t*) heap_caps_malloc(total_chunk_size, MALLOC_CAP_SPIRAM);
  
  if (chunk_buffer == NULL) {
    Serial.println("PSRAM Buffer failed! Defaulting to slow writes.");
    uint8_t frame_header[8] = {0x30, 0x30, 0x64, 0x63, (uint8_t)(frame_size & 0xFF), (uint8_t)((frame_size >> 8) & 0xFF), (uint8_t)((frame_size >> 16) & 0xFF), (uint8_t)((frame_size >> 24) & 0xFF)};
    file.write(frame_header, 8);
    file.write(buf, len);
    if (padding) { uint8_t pad_byte = 0x00; file.write(&pad_byte, 1); }
    movi_size += total_chunk_size;
    return;
  }

  chunk_buffer[0] = 0x30; chunk_buffer[1] = 0x30; chunk_buffer[2] = 0x64; chunk_buffer[3] = 0x63;
  chunk_buffer[4] = frame_size & 0xFF;
  chunk_buffer[5] = (frame_size >> 8) & 0xFF;
  chunk_buffer[6] = (frame_size >> 16) & 0xFF;
  chunk_buffer[7] = (frame_size >> 24) & 0xFF;

  memcpy(&chunk_buffer[8], buf, len);

  if (padding) {
    chunk_buffer[8 + len] = 0x00;
  }

  file.write(chunk_buffer, total_chunk_size);
  free(chunk_buffer);
  movi_size += total_chunk_size;
}

void end_avi(File &file, int frames) {
  uint32_t file_size = movi_size + 324 - 8;
  
  file.seek(4);
  file.write((uint8_t*)&file_size, 4);

  file.seek(48);
  file.write((uint8_t*)&frames, 4);
  file.seek(140);
  file.write((uint8_t*)&frames, 4);

  file.seek(320);
  file.write((uint8_t*)&movi_size, 4);
  
  file.close();
}